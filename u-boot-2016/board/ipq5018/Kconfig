## u-boot-2016/board/ipq5018/Kconfig
```kconfig
if ARCH_IPQ5018

config SYS_CPU
       default "ipq5018"

config SYS_BOARD
       default "ipq5018"

config SYS_VENDOR
       default "qca/arm"

config SYS_CONFIG_NAME
       default "ipq5018"

config IPQ_I2C
	bool "Enable i2c support on IPQ platform"

config USB_XHCI_IPQ
	bool "Enable usb support for ipq5018"

config PCI_IPQ
	bool "Enable pci support for ipq5018"

config MMC_FLASH
	bool "Enable MMC flash support for ipq5018"

config IPQ_TZT
	bool "Enable TZ test command for ipq5018"

config UBI_WRITE
	bool "Enable ubi volume write command for ipq5018"

config QPIC_SERIAL
	bool "Enable QPIC serial spi nand  for ipq5018"

config IPQ_TINY
	bool "Enable Tiny support for ipq5018"

config IPQ_MTD_NOR
	bool "Register nor in MTD framework for ipq5018"

config IPQ_TINY_SPI_NOR
	bool "This config helps to update spi-nor related updated in ipq5018"

config NAND_FLASH
	bool "Enable NAND driver for ipq5018"

config GEPHY
	bool "Enable Internel GEPHY for ipq5018"

config ART_COMPRESSED
	bool "Enable uncompress support for ipq5018"

config BOARD_TYPES
	bool "Support board_type member in global data"
	default y

config LIST_OF_CONFIG_NAMES_SUPPORT
	bool "List of config names support"

config LIST_FUSE
	bool "Enable fuse list command"
	default n

config TARGET_IPQ5018_CMCC_MR3000D_CI
    bool "CMCC MR3000D-CI board support"
	default n
    help
	  Enable support for CMCC MR3000D-CI board

config TARGET_IPQ5018_CMCC_PZ_L8
    bool "CMCC PZ-L8 board support"
	default n
    help
	  Enable support for CMCC PZ-L8 board

config TARGET_IPQ5018_CMCC_RAX3000Q
    bool "CMCC RAX3000Q(Y) board support"
	default n
    help
	  Enable support for CMCC RAX3000Q(Y) board

config TARGET_IPQ5018_CUCC_VS010
    bool "CUCC VS010 board support"
	default n
    help
	  Enable support for CUCC VS010 board

config TARGET_IPQ5018_JDCLOUD_AX3000
    bool "JDCloud AX3000 board support"
	default n
    help
	  Enable support for JDCloud AX3000 board

config TARGET_IPQ5018_LYW_30M
    bool "Lingyan LYW-30M recovery board support"
	default n
    help
	  Enable support for the Boardcom AX3000_Q06_V2.0 LYW-30M
	  IPQ5018 recovery bootloader.
endif
```
